## config/boards/shields/vlk/Kconfig.defconfig
```kconfig
if SHIELD_VLK

# Name must be less than 16 characters long!
config ZMK_KEYBOARD_NAME
    default "VLK Keeb"

endif
```

## config/boards/shields/vlk/Kconfig.shield
```kconfig
## The Kconfig.shield file defines the shield name used to build your keyboard.
# No whitespace after the comma or in your keyboard name!
config SHIELD_VLK
    def_bool $(shields_list_contains,vlk)
```
